/* Projeto Lora Ebyte ardunino nano
 * Monitor de Energia Monofasica Residencial com Transmissão Lora - Classe C
 * AUTOR MATEUS OLIVEIRA DE PAULA
 * DATA 29.10.2022
 */
#include "string.h"
#include <avr/wdt.h>
#include "LoRa_E32.h"
#include "EmonLib.h" 
#include <Adafruit_GFX.h>         
#include <Adafruit_SSD1306.h>     
#include <SPI.h>                  
#include <Wire.h>                 
#include <SoftwareSerial.h>
//++++++++++++++++++++++++++++++
//Difinicoes do display Oled
#define OLED_SDA_PIN    5
#define OLED_SCL_PIN    4
#define SCREEN_WIDTH    128 
#define SCREEN_HEIGHT   64  
#define OLED_ADDR       0x3C 
//++++++++++++++++++++++++++++++
EnergyMonitor emon1;             
//++++++++++++++++++++++++++++++ 
LoRa_E32 e32ttl(2, 3); 
//++++++++++++++++++++++++++++++ 
//Variáveis globais

float y=0;         //variável que armazena a soma do valor a ser pago
float x=0;         //variável que armazena o valor a ser pago
int segundo=0;     //Variável para segundos do contador
int minuto=0;      //Variável para minutos do contador
int hora=0;        //Variável para horas do contador
int dia=0;         //Variável para dias do contador
//++++++++++++++++++++++++++++++ 
//++++++++++++++++++++++++++++++
Adafruit_SSD1306 display(4);//
//++++++++++++++++++++++++++++++ 
const unsigned char logoespk8 [] PROGMEM = {
//Logo Espk8 128x64px
  0xff, 0xff, 0xff, 0xff, 0xff, 0xff, 0xff, 0xff, 0xff, 0xff, 0xff, 0xff, 0xff, 0xff, 0xff, 0xff, 
  0xff, 0xff, 0xff, 0xff, 0xff, 0xff, 0xff, 0xff, 0xff, 0xff, 0xff, 0xff, 0xff, 0xff, 0xff, 0xff, 
  0xff, 0xff, 0xff, 0xff, 0xff, 0xff, 0xff, 0xff, 0xff, 0xff, 0xff, 0xff, 0xff, 0xff, 0xff, 0xff, 
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  0xff, 0xff, 0xff, 0xff, 0xff, 0xff, 0xff, 0xff, 0xff, 0xff, 0xff, 0xff, 0xff, 0xff, 0xff, 0xff
};
//++++++++++++++++++++++++++++++
// Funcao display 
void display_init(void);
//++++++++++++++++++++++++++++++
//Funcao inicializa comunicacao com display Oled (Parametros: Nenhum - Retorno: Nenhum.
void display_init(void)
{
    if(!display.begin(SSD1306_SWITCHCAPVCC, OLED_ADDR)) 
    {
        Serial.println("Falha ao inicializar comunicacao com OLED");
        //Loop Infinito ate comunicar
                
    }
    else
    {
        Serial.println("Comunicacao com OLED inicializada com sucesso");
    
        // Limpa display e configura tamanho de fonte e cor 
        // display.clearDisplay();
        // display.setTextSize(1);
        // display.setTextColor(WHITE);
    }
};

//===========================================
void setup()
{  

  Serial.begin(9600);
  delay(1000);
  e32ttl.begin();
  

  
  emon1.voltage(0, 218.7, 1.7);  // Voltage: input pin, calibration, phase_shift
  emon1.current(6, 0.60607); //Calibragem do resitor de carga 330 Ohms);  Current: input pin, calibration.


//==========================================
  display_init();
 // display.begin(SSD1306_SWITCHCAPVCC, 0x3C);  
  display.clearDisplay();                   
  display.drawBitmap(0,0, logoespk8 , 128, 64, 1);
  //display.setTextWrap(false);               
  display.setTextColor(WHITE);                
  display.setTextSize(1);                     
  display.display(); 
//==========================================
  

}

void loop()
{
  emon1.calcVI(17,2000);         // Calculate all. No.of half wavelengths (crossings), time-out
 // emon1.serialprint();           // Print out all variables (realpower, apparent power, Vrms, Irms, power factor)
  
  float realPower       = emon1.realPower;        //extract Real Power into variable
  float apparentPower   = emon1.apparentPower;    //extract Apparent Power into variable
  float powerFActor     = emon1.powerFactor;      //extract Power Factor into Variable
  float supplyVoltage   = emon1.Vrms;             //extract Vrms into Variable
  float Irms            = emon1.Irms;             //extract Irms into Variable

   if(Irms<0.03){Irms=0;}
//Implementa um contador
       segundo=segundo+1;
       if (segundo >=60) {segundo = 0; minuto = minuto+1;}
       if (minuto >=60){segundo =0;minuto=0;hora = hora+1;}
       if (hora >23){segundo=0;minuto=0;hora =0; dia+1;}
       
       delay(1000); //Espera 1 segundo no total
     
     x=(apparentPower /1000);//*total); //calcula e guarda em x o valor do consumo em reais
     y=y+x; //após 1 segundo, soma e guarda em y o valor de x portanto y é o KW/h.
//===================================================================================

  display.clearDisplay();                    
  display.setTextColor(WHITE);
  display.setTextSize(1);
  display.setCursor(1,1);
  display.println("Tensao/Volts:");
  display.setTextSize(2);
  display.setCursor(20,15);
  display.println(supplyVoltage);
  display.display(); 
struct Message {
	    char type[5] = "TENS";
	 
	    byte tensao[4];
	} message;


	*(float*)(message.tensao) = supplyVoltage;
//	message.tensao = supplyVoltage;
 Serial.print("Voltagem: ");
 Serial.println(supplyVoltage);
 //mySerial.println(message.tensao);
 

    ResponseStatus rs = e32ttl.sendMessage(&message,sizeof(Message));
   	Serial.println(rs.getResponseDescription());
     delay(3000);
//====================================   
  display.clearDisplay();                     
  display.setTextColor(WHITE);
  display.setTextSize(1);
  display.setCursor(1,1);
  display.println("Corrent/Amper:");
  display.setTextSize(2);
  display.setCursor(20,15);
  display.println(Irms);  
  display.display(); 
struct Message1 {
	    char type[5] = "AMPE";
	 
	    byte amper[4];
	} message1;


	*(float*)(message1.amper) = Irms;
//	message.tensao = supplyVoltage;
 Serial.print("Amperagem ");
 Serial.println(Irms);
 //mySerial.println(message.tensao);
 

    rs = e32ttl.sendMessage(&message1,sizeof(Message1));
   	Serial.println(rs.getResponseDescription());
     delay(3000);
//=====================================   
  display.clearDisplay();                     
  display.setTextColor(WHITE);
  display.setTextSize(1);
  display.setCursor(1,1);
  display.println("Poten/Real:");
  display.setTextSize(2);
  display.setCursor(20,15);
  display.println(realPower);
  display.display(); 

  struct Message2 {
	    char type[5] = "WATR";
	 
	    byte watr[4];
	} message2;


	*(float*)(message2.watr) = realPower;
//	message.tensao = supplyVoltage;
 Serial.print("Potencia Aparente: ");
 Serial.println(realPower);
 //mySerial.println(message.tensao);
 

     rs = e32ttl.sendMessage(&message2,sizeof(Message2));
   	Serial.println(rs.getResponseDescription());
     delay(3000);
//=====================================
   
  display.clearDisplay();                    
  display.setTextSize(1);
  display.setCursor(1,1);
  display.println("Poten/Aparen:");
  display.setTextSize(2);
  display.setCursor(20,15);
  display.println(apparentPower);
  display.display(); 

  struct Message3 {
	    char type[5] = "WATA";
	 
	    byte wata[4];
	} message3;


	*(float*)(message3.wata) = apparentPower;
//	message.tensao = supplyVoltage;
 Serial.print("Potencia Aparente: ");
 Serial.println(apparentPower);
 //mySerial.println(message.tensao);
 

     rs = e32ttl.sendMessage(&message3,sizeof(Message3));
   	Serial.println(rs.getResponseDescription());
     delay(3000);
//=====================================
  display.clearDisplay();                     
  display.setTextColor(WHITE);
  display.setTextSize(1);
  display.setCursor(1,1);
  display.println("Fator/Potencia");
  display.setTextSize(2);
  display.setCursor(20,15);
  display.println(powerFActor); 
  display.display(); 

 struct Message4 {
	    char type[5] = "FWHO";
	 
	    byte fwho[4];
	} message4;


	*(float*)(message4.fwho) =powerFActor;
//	message.tensao = supplyVoltage;
 Serial.print("KW/h: ");
 Serial.println(powerFActor);
 //mySerial.println(message.tensao);
 

     rs = e32ttl.sendMessage(&message4,sizeof(Message4));
   	Serial.println(rs.getResponseDescription());
     delay(3000);
//=======================================================
  display.clearDisplay();                     
  display.setTextColor(WHITE);
  display.setTextSize(1);
  display.setCursor(1,1);
  display.println("KW/H:");
  display.setTextSize(2);
  display.setCursor(20,15);
  display.println(y);  
  display.display(); 

 struct Message5 {
	    char type[5] = "KWHO";
	 
	    byte kwho[4];
	} message5;


	*(float*)(message5.kwho) = y;
//	message.tensao = supplyVoltage;
 Serial.print("KW/h: ");
 Serial.println(y);
 //mySerial.println(message.tensao);
 

     rs = e32ttl.sendMessage(&message5,sizeof(Message5));
   	Serial.println(rs.getResponseDescription());
     delay(3000);
  
 
  
}
